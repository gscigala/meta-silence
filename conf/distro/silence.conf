## conf/distro/silence.conf
```bitbake
require conf/distro/poky.conf

include conf/machine/${MACHINE}-extra.conf

DISTRO = "silence"
DISTRO_NAME = "Silence"
DISTRO_VERSION = "0.2.0"

VIRTUAL-RUNTIME_init_manager = "systemd"
DISTRO_FEATURES_BACKFILL_CONSIDERED = "sysvinit"
VIRTUAL-RUNTIME_initscripts = ""
DISTRO_FEATURES:append = " systemd usrmerge"

hostname_pn-base-files ?= "silence"

DISTRO_FEATURES:remove = " nfs"
```

## conf/layer.conf
```bitbake
# We have a conf and classes directory, add to BBPATH
BBPATH .= ":${LAYERDIR}"

# We have a packages directory, add to BBFILES
BBFILES += "${LAYERDIR}/recipes-*/*/*.bb \
            ${LAYERDIR}/recipes-*/*/*.bbappend"

BBFILE_COLLECTIONS += "silence-layer"
BBFILE_PATTERN_silence-layer := "^${LAYERDIR}/"
BBFILE_PRIORITY_silence-layer = "4"

LAYERSERIES_COMPAT_silence-layer = "gatesgarth"
```
